////////////////////////////////////////////////////////////////////////////////////////////////////////////////////////////
////////////////////////////////////////////////////////////////////////////////////////////////////////////////////////////
//// Código para un dispensador de comida basado en un tornillo sin fin que rota sobre su eje por la acción
//// de un motor DC > 5V y sobre uno de sus extremos por la acción de un motor paso a paso para una distribución
//// uniforme circular. Tiene también un sistema de alarma para cuando se active la rotación que consiste en dos leds y 
//// la emisión de un sonido.
//// Elaborado por Christian David para Creatvra en el marco del proyecto .
////////////////////////////////////////////////////////////////////////////////////////////////////////////////////////////
////////////////////////////////////////////////////////////////////////////////////////////////////////////////////////////

//dar permisos desde Linux sudo chmod a+rw /dev/ttyACM0

////////////////////////////////////////////////////////////////////////////////////////////////////////////////////////////
////////////////////////////////////////////////////////////////////////////////////////////////////////////////////////////
//// Librerías
////////////////////////////////////////////////////////////////////////////////////////////////////////////////////////////
////////////////////////////////////////////////////////////////////////////////////////////////////////////////////////////


#include <Wire.h>
#include "Sodaq_DS3231.h" //Librería para el módulo RTC DS3231.


////////////////////////////////////////////////////////////////////////////////////////////////////////////////////////////
////////////////////////////////////////////////////////////////////////////////////////////////////////////////////////////
//Convenciones para la conexión del módulo RTC DS3231 - Reloj:
// Fecha, Hora, Temperatura y dia de la semana 
// Conexión RTC :Arduino UNO    GND->GND VCC->5V SCL-> SCL  SDA->SDA los dos pines despues del ...12,13,GND,AREF,SDA,SCL
////////////////////////////////////////////////////////////////////////////////////////////////////////////////////////////
////////////////////////////////////////////////////////////////////////////////////////////////////////////////////////////

////////////////////////////////////////////////////////////////////////////////////////////////////////////////////////////
////////////////////////////////////////////////////////////////////////////////////////////////////////////////////////////
//Lista para el día de la semana y nomenclatura de iniciación para configurar por primera vez el RTC
char DiaSemana[][4] = {"Dom", "Lun", "Mar", "Mie", "Jue", "Vie", "Sab" };

    // La línea fija la fecha, hora y dia de la semana, se debe suprimir la linea en la segunda carga
    // Ejemplo 2017 Julio 12,2:20:00 pm dia 1-Lunes (0=Dom, 1=Lun, 2=Mar, 3=Mie, 4=Jue, 5=Vie, 6=Sab)
//DateTime dt(2021, 6, 28, 13, 02, 10, 1);

////////////////////////////////////////////////////////////////////////////////////////////////////////////////////////////
////////////////////////////////////////////////////////////////////////////////////////////////////////////////////////////


////////////////////////////////////////////////////////////////////////////////////////////////////////////////////////////
////////////////////////////////////////////////////////////////////////////////////////////////////////////////////////////
//// Inicialización del motor paso a paso.
////////////////////////////////////////////////////////////////////////////////////////////////////////////////////////////
////////////////////////////////////////////////////////////////////////////////////////////////////////////////////////////
//Se define el pin de dirección (dir) como el 9 y el pin de paso (stp) como el 8.
//Se define pasos por revolución (stepsPerRevolution) 200 son una revolución completa.
#define dirPin 9
#define stepPin 8
#define stepsPerRevolution 200
////////////////////////////////////////////////////////////////////////////////////////////////////////////////////////////
////////////////////////////////////////////////////////////////////////////////////////////////////////////////////////////


////////////////////////////////////////////////////////////////////////////////////////////////////////////////////////////
////////////////////////////////////////////////////////////////////////////////////////////////////////////////////////////
//// Inicialización para el parlante con el módulo ISD1820.
////////////////////////////////////////////////////////////////////////////////////////////////////////////////////////////
////////////////////////////////////////////////////////////////////////////////////////////////////////////////////////////

// Definición del pin que activa la voz en el módulo ISD1829 como el pin 5.

int P_E = 5; 

////////////////////////////////////////////////////////////////////////////////////////////////////////////////////////////
////////////////////////////////////////////////////////////////////////////////////////////////////////////////////////////

////////////////////////////////////////////////////////////////////////////////////////////////////////////////////////////
////////////////////////////////////////////////////////////////////////////////////////////////////////////////////////////
//// Inicialización para el motor DC >5V.
////////////////////////////////////////////////////////////////////////////////////////////////////////////////////////////
////////////////////////////////////////////////////////////////////////////////////////////////////////////////////////////

// Definición del pin que activa el motor como el pin 3.

int ControlPin = 3;   

// Definición de la velocidad del motor.

int velMotor = 15;

////////////////////////////////////////////////////////////////////////////////////////////////////////////////////////////
////////////////////////////////////////////////////////////////////////////////////////////////////////////////////////////

////////////////////////////////////////////////////////////////////////////////////////////////////////////////////////////
////////////////////////////////////////////////////////////////////////////////////////////////////////////////////////////
//// Inicialización de la señal luminosa.
////////////////////////////////////////////////////////////////////////////////////////////////////////////////////////////
////////////////////////////////////////////////////////////////////////////////////////////////////////////////////////////

// Definición del pin que activa el led verde.

int ledVerde = 7;   

// Definición del pin que activa el led rojo.

int ledRojo = 6;

////////////////////////////////////////////////////////////////////////////////////////////////////////////////////////////
////////////////////////////////////////////////////////////////////////////////////////////////////////////////////////////
//// Definición de la hora, minuto y segundo elegido para la distribución de la comida.

int horaElegida = 19;
int minutoElegido = 20;
int segundoElegido = 52;

////////////////////////////////////////////////////////////////////////////////////////////////////////////////////////////
////////////////////////////////////////////////////////////////////////////////////////////////////////////////////////////

void setup () 
{
    Serial.begin(9600);
    Wire.begin();
    rtc.begin();
   // La línea fija la fecha, hora y día de la semana, se debe suprimir la línea en la segunda carga 
    //rtc.setDateTime(dt);

    /////////////////////////////////////////////////////////////////////////
    //Definición de los pines de los leds como de salida (OUTPUT).
    pinMode(ledVerde, OUTPUT);
    pinMode(ledRojo, OUTPUT);
    /////////////////////////////////////////////////////////////////////////

    /////////////////////////////////////////////////////////////////////////
    //Definición de los pines del motor paso a paso como de salida (OUTPUT).
    pinMode(stepPin, OUTPUT);
    pinMode(dirPin, OUTPUT);
    /////////////////////////////////////////////////////////////////////////

    /////////////////////////////////////////////////////////////////////////
    //Definición deel pin del módulo ISD1820 como de salida (OUTPUT).
    pinMode(P_E, OUTPUT);
    /////////////////////////////////////////////////////////////////////////
    
    /////////////////////////////////////////////////////////////////////////
    //Definición del pin del motor DC del tornillo como de salida (OUTPUT).
    pinMode(ControlPin, OUTPUT);
    /////////////////////////////////////////////////////////////////////////
}

void loop () 
{
    Serial.print(rtc.getTemperature()); //Escribe la temperatura.
    Serial.println("*C");
    DateTime now = rtc.now();
    Serial.print(now.year(), DEC); //Escribe el año.
    Serial.print('/');
    Serial.print(now.month(), DEC); //Escribe el mes.
    Serial.print('/');
    Serial.print(now.date(), DEC); //Escribe el día.
    Serial.print(' ');
    Serial.print(now.hour(), DEC); //Escribe la hora.
    Serial.print(':');
    Serial.print(now.minute(), DEC); //Escribe el minuto.
    Serial.print(':');
    Serial.print(now.second(), DEC); //Escribe el segundo.
    Serial.print(' ');
    Serial.print(DiaSemana[now.dayOfWeek()]); //Escribe el día de la semana.
    Serial.println();

    rtc.convertTemperature();        //Convierte el  registro de la temperatura.


    /////////////////////////////////////////////////////////////////////////
    //Condición para encender el sistema de alarma, rotación y distribución
    /////////////////////////////////////////////////////////////////////////
    
    if ( now.hour() == horaElegida && now.minute() == minutoElegido && now.second() == segundoElegido ) 
   {
    
      digitalWrite(ledVerde, HIGH);//Enciende el led verde.
      digitalWrite(ledRojo, HIGH);//Enciende el led rojo.
      digitalWrite(P_E, HIGH);//Enciende el módulo del parlante.
      digitalWrite(ControlPin, HIGH); // Enciende el motor DC del tornillo.
      analogWrite(ControlPin, velMotor); // Controla la velocidad del motor DC del tornillo.
         
      ////////////////////////////////////////////////////////
      ///////// Inicio sequencia del motor paso a paso ///////
      ////////////////////////////////////////////////////////
      
      //Inicia con un giro en dirección de las manecillas del reloj:
      digitalWrite(dirPin, HIGH);
      // Este for es para que haga los pasos que se le han pedido al inicio con la constante "stepsPerRevolution"
      for (int i = 0; i < stepsPerRevolution; i++) {
           // Estas cuatro líneas resultan en un paso:
           digitalWrite(stepPin, HIGH);
           delayMicroseconds(2000); //Velocidad de giro, entre menor sea el número, mayor será la velocidad.
           digitalWrite(stepPin, LOW);
           delayMicroseconds(2000);
            }
      delay(10000);// Tiempo de espera para que se devuelva.
      // Continúa con un giro en contra de la dirección de las manecillas del reloj:
      digitalWrite(dirPin, LOW);
      // Este for es para que haga los pasos que se le han pedido al inicio con la constante "stepsPerRevolution"
      for (int i = 0; i < stepsPerRevolution; i++) {
          // Estas cuatro líneas resultan en un paso:
          digitalWrite(stepPin, HIGH);
          delayMicroseconds(2000); //Velocidad de giro, entre menor sea el número, mayor será la velocidad.
          digitalWrite(stepPin, LOW);
          delayMicroseconds(2000);
            }
      delay(2000);// Tiempo de espera para que pase al siguiente bloque de órdenes.

      /////////////////////////////////////////////
      ///////// Fin sequencia del motor //////////
      ///////////////////////////////////////////

      digitalWrite(ledVerde, LOW);//Apaga el led verde.
      digitalWrite(ledRojo, HIGH);//Sigue el led rojo prendido.
      digitalWrite(P_E, HIGH);//Sigue el parlante emitiendo un sonido
      digitalWrite(ControlPin, LOW);  // Apaga el motor DC del tornillo. 
      delay(5000);// Tiempo de espera para que pase al siguiente bloque de órdenes. 
      
      digitalWrite(7, LOW);//Apaga el led verde.
      digitalWrite(6, LOW);//Apaga el led rojo.
      digitalWrite(P_E, LOW);//Apaga el parlante.
      digitalWrite(ControlPin, LOW);//Apaga el motor DC del tornillo.
      delay(5000);
            
    }else{//Bloque de órdenes que se ejecutan en caso de que no se cumpla la condición inicial (de la hora elegida)

           digitalWrite(7, LOW);//Apaga el led verde.
           digitalWrite(6, LOW);//Apaga el led rojo.
           digitalWrite(P_E, LOW);//Apaga el parlante.
           digitalWrite(ControlPin, LOW);//Apaga el motor DC del tornillo.    
         }

 
   delay(800); // Tiempo en el que refresca la información
}
